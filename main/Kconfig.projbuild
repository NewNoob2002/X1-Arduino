## main/Kconfig.projbuild
```kconfig
menu "Project Configuration"

    menu "BAT I2C Master"
        config I2C_MASTER_FREQUENCY
            int "Master Frequency"
            default 400000
            help
                I2C Speed of Master device.
    endmenu

    menu "APP_Version"
        config APP_VERSION
            string "APP_Version"
            default "1.0.0"
            help
                APP Version.
    endmenu

endmenu
```
